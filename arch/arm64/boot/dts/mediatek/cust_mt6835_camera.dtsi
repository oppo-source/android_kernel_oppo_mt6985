// SPDX-License-Identifier: GPL-2.0
/* Copyright (c) 2020 MediaTek Inc. */
/* CAMERA GPIO standardization */


//#include "mediatek/cust_mt6835_camera_common.dtsi"
#include "mediatek/cust_mt6835_camera_chongqing.dtsi"

